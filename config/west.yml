## config/west.yml
```yaml
manifest:
  defaults:
    revision: v0.3
  remotes:
    - name: zmkfirmware
      url-base: https://github.com/zmkfirmware
    - name: jlovald
      url-base: https://github.com/jlovald
  projects:
    - name: zmk
      remote: zmkfirmware
      import: app/west.yml
    - name: gggw-zmk-keebs
      remote: jlovald
      revision: alignWithMain
      import: config/west.yml
  self:
    path: config
```
